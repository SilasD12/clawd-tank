## firmware/sdkconfig.defaults
```kconfig
# firmware/sdkconfig.defaults

# BLE (NimBLE)
CONFIG_BT_ENABLED=y
CONFIG_BT_NIMBLE_ENABLED=y
CONFIG_BT_NIMBLE_ROLE_PERIPHERAL=y
CONFIG_BT_NIMBLE_ROLE_CENTRAL=n
CONFIG_BT_NIMBLE_ROLE_OBSERVER=n
CONFIG_BT_NIMBLE_ROLE_BROADCASTER=n
CONFIG_BT_NIMBLE_ATT_PREFERRED_MTU=256

# SPI LCD
CONFIG_LCD_HOST_SPI2=y

# Flash (ESP32-PICO-V3-02 has 8MB flash)
CONFIG_ESPTOOLPY_FLASHSIZE_8MB=y
CONFIG_ESPTOOLPY_FLASHSIZE="8MB"

# PSRAM (ESP32-PICO-V3-02 has 2MB PSRAM)
CONFIG_ESP32_SPIRAM_SUPPORT=y
CONFIG_SPIRAM=y
CONFIG_SPIRAM_USE_MALLOC=y

# LVGL
CONFIG_LV_COLOR_DEPTH_16=y
CONFIG_LV_FONT_MONTSERRAT_8=y
CONFIG_LV_FONT_MONTSERRAT_10=y
CONFIG_LV_FONT_MONTSERRAT_12=y
CONFIG_LV_FONT_MONTSERRAT_14=y
CONFIG_LV_FONT_MONTSERRAT_18=y

# FreeRTOS
CONFIG_FREERTOS_HZ=1000

# IRAM reduction — moves code to flash to fix overflow with BLE+SPI+LVGL
CONFIG_SPI_MASTER_ISR_IN_IRAM=n
CONFIG_FREERTOS_PLACE_FUNCTIONS_INTO_FLASH=y
```
